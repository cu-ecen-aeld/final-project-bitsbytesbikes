## rpi-build/conf/bblayers.conf
```bitbake
# POKY_BBLAYERS_CONF_VERSION is increased each time build/conf/bblayers.conf
# changes incompatibly
POKY_BBLAYERS_CONF_VERSION = "2"

BBPATH = "${TOPDIR}"
BBFILES ?= ""

BBLAYERS ?= " \
  /home/baggio/repos/coursera/final-project-bitsbytesbikes/poky/meta \
  /home/baggio/repos/coursera/final-project-bitsbytesbikes/poky/meta-poky \
  /home/baggio/repos/coursera/final-project-bitsbytesbikes/poky/meta-yocto-bsp \
  /home/baggio/repos/coursera/final-project-bitsbytesbikes/meta-raspberrypi \
  /home/baggio/repos/coursera/final-project-bitsbytesbikes/meta-openembedded/meta-oe \
  /home/baggio/repos/coursera/final-project-bitsbytesbikes/meta-openembedded/meta-python \
  /home/baggio/repos/coursera/final-project-bitsbytesbikes/meta-aesd \
  "
```
